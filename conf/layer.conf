## conf/layer.conf
```bitbake
# We have a conf and classes directory, add to BBPATH
BBPATH .= ":${LAYERDIR}"

# We have a packages directory, add to BBFILES
BBFILES += "${LAYERDIR}/recipes-*/*/*.bb \
            ${LAYERDIR}/recipes-*/*/*.bbappend"

BBFILE_COLLECTIONS += "meta-dec-nxp"
BBFILE_PATTERN_meta-dec-nxp := "^${LAYERDIR}/"
BBFILE_PRIORITY_meta-dec-nxp = "10"

IMAGE_INSTALL:append = "\
	sdma \
	${@bb.utils.contains('MACHINE_FEATURES', 'wifi', 'nxp-wifi-systemd', '', d)} \
	${@bb.utils.contains('MACHINE_FEATURES', 'bluetooth', 'nxp-bluetooth-systemd', '', d)} \
		 "
KERNEL_MODULE_AUTOLOAD += "sdma"

LAYERSERIES_COMPAT_meta-dec-nxp = "scarthgap"
LICENSE_FLAGS_ACCEPTED = "commercial"
```

## conf/machine/imx91-dec-kit.conf
```bitbake
#@TYPE: Machine
#@NAME: Diamond Technologies NXP i.MX 91
#@SOC: i.MX91
#@DESCRIPTION: Machine configuration for Diamond Technologies NXP i.MX 91 Kit
#@MAINTAINER: Diamond Technologies

MACHINEOVERRIDES =. "mx91:"

require include/imx91-dec-kit.inc

DISTRO_NAME = "Diamond Technologies i.MX Release Distro"

KERNEL_DEVICETREE = " \
    freescale/imx91-dec-kit.dtb \
"

KERNEL_DTB = "imx91-dec-kit.dtb"

UBOOT_DTB_NAME = "imx91-dec-kit.dtb"
UBOOT_CONFIG_BASENAME = "imx91_dec"

DDR_FIRMWARE_NAME = " \
    lpddr4_dmem_1d_v202201.bin \
    lpddr4_dmem_2d_v202201.bin \
    lpddr4_imem_1d_v202201.bin \
    lpddr4_imem_2d_v202201.bin \
"

IMXBOOT_TARGETS = "flash_singleboot"

MACHINE_ESSENTIAL_EXTRA_RDEPENDS += "kernel-image kernel-devicetree"

MACHINE_FEATURES:append = " dpdk rdp nxpwifi-all-sdio 00363 00365 "
MACHINE_FIRMWARE:append = " linux-firmware-rtl-nic "

WKS_FILE = "imx-dec-boot-bootpart.wks.in"

# This SOM uses a different EEPROM format than other Diamond Technologies boards
IMAGE_INSTALL:remove = "dec-eeprom-decoder dec-eeprom-services"
```

## conf/machine/imx93-dec-kit.conf
```bitbake
#@TYPE: Machine
#@NAME: Diamond Technologies NXP i.MX 93
#@SOC: i.MX93
#@DESCRIPTION: Machine configuration for Diamond Technologies NXP i.MX 93 Kit
#@MAINTAINER: Diamond Technologies

MACHINEOVERRIDES =. "mx93:"

require include/imx93-dec-kit.inc

DISTRO_NAME = "Diamond Technologies i.MX Release Distro"

KERNEL_DEVICETREE = " \
    freescale/imx93-dec-kit.dtb \
    freescale/imx93-dec-kit-5.5.dtb \
    freescale/imx93-dec-kit-10.1.dtb \
"

KERNEL_DTB = "imx93-dec-kit.dtb"

UBOOT_DTB_NAME = "imx93-dec-kit.dtb"
UBOOT_CONFIG_BASENAME = "imx93_dec"

DDR_FIRMWARE_NAME = " \
    lpddr4_dmem_1d_v202201.bin \
    lpddr4_dmem_2d_v202201.bin \
    lpddr4_imem_1d_v202201.bin \
    lpddr4_imem_2d_v202201.bin \
"

IMXBOOT_TARGETS = "flash_singleboot"

MACHINE_ESSENTIAL_EXTRA_RDEPENDS += "kernel-image kernel-devicetree"

MACHINE_FEATURES:append = " dpdk rdp nxpwifi-all-sdio 00363 00365 "
MACHINE_FIRMWARE:append = " ethos-u-firmware ap1302-firmware linux-firmware-rtl-nic "

WKS_FILE = "imx-dec-boot-bootpart.wks.in"

# This SOM uses a different EEPROM format than other Diamond Technologies boards
IMAGE_INSTALL:remove = "dec-eeprom-decoder dec-eeprom-services"
```
